## boards/shields/Sweep35/Kconfig.defconfig
```kconfig
# Copyright (c) 2020 The ZMK Contributors
# SPDX-License-Identifier: MIT

if SHIELD_SWEEP35_LEFT

config ZMK_KEYBOARD_NAME
    default "Sweep35"

config ZMK_SPLIT_ROLE_CENTRAL
    default y

endif

if SHIELD_SWEEP35_LEFT || SHIELD_SWEEP35_RIGHT

config ZMK_SPLIT
    default y

endif

CONFIG_ZMK_STUDIO=y
CONFIG_ZMK_STUDIO_LOCKING=n
```

## boards/shields/sweep36/Kconfig.shield
```kconfig
# Copyright (c) 2020 The ZMK Contributors
# SPDX-License-Identifier: MIT

config SHIELD_SWEEP35_LEFT
    def_bool $(shields_list_contains,sweep35_left)

config SHIELD_SWEEP35_RIGHT
    def_bool $(shields_list_contains,sweep35_right)
```
