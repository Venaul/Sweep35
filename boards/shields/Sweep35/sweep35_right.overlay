/*
 * Copyright (c) 2020 The ZMK Contributors
 *
 * SPDX-License-Identifier: MIT
 */

#include "sweep35.dtsi"

/ {
    chosen {
        zmk,keyboard = &sweep35_right;
    };

    sweep35_right: sweep35_right {
        compatible = "zmk,keyboard";
        label = "Sweep35 Right Half";

        kscan = <&kscan0>;
        keymap = <&sweep35>;
    };

    &default_transform {
        col-offset = <5>;
    };
};
