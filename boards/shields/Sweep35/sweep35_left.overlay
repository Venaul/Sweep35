/*
 * Copyright (c) 2020 The ZMK Contributors
 *
 * SPDX-License-Identifier: MIT
 */

#include "sweep35.dtsi"

/ {
    chosen {
        zmk,keyboard = &sweep35_left;
    };

    sweep35_left: sweep35_left {
        compatible = "zmk,keyboard";
        label = "Sweep35 Left Half";

        matrix-transform = <&default_transform>;
        kscan = <&kscan0>;
        keymap = <&sweep35>;
    };
};
